## boards/shields/dongle_screen_240/Kconfig.shield
```kconfig
config SHIELD_DONGLE_SCREEN_240
    def_bool $(shields_list_contains,dongle_screen_240)
```

## boards/shields/sofle_dongle/Kconfig.defconfig
```kconfig
#nombre del archivo kconfig.defconfig

if SHIELD_SOFLE_DONGLE

config ZMK_KEYBOARD_NAME
    default "Sofle Dongle"

config ZMK_SPLIT_ROLE_CENTRAL
    default y

config ZMK_SPLIT
    default y

config ZMK_SPLIT_BLE_CENTRAL_PERIPHERALS
    default 2

config BT_MAX_CONN
    default 3

config BT_MAX_PAIRED
    default 3

config ZMK_DISPLAY
    default y

config SSD1306
    default y

config I2C
    default y

config LV_Z_MEM_POOL_SIZE
    default 12288

config LV_Z_VDB_SIZE
    default 100

config LV_DPI_DEF
    default 148

config LV_Z_BITS_PER_PIXEL
    default 1

endif
```

## config/west.yml
```yaml
manifest:
  remotes:
    - name: zmkfirmware
      url-base: https://github.com/zmkfirmware
    - name: Greverf
      url-base: https://github.com/Greverf
  projects:
    - name: zmk
      remote: zmkfirmware
      revision: main
      import: app/west.yml
    - name: prospector-zmk-module
      remote: Greverf
      revision: feat/new-status-screens
  self:
    path: config
```
